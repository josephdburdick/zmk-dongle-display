/*
 * Copyright (c) 2024 The ZMK Contributors
 *
 * SPDX-License-Identifier: MIT
 */

/ {
    behaviors {
        /* Bind &dflip to a key or combo to rotate the display 180 degrees. */
        dflip: dflip {
            compatible = "zmk,behavior-display-flip";
            #binding-cells = <0>;
            display-name = "Flip Display";
        };
    };
};
