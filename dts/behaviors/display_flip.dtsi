/*
 * Copyright (c) 2026 The ZMK Contributors
 *
 * SPDX-License-Identifier: MIT
 */

/ {
    behaviors {
        /* Bind &dflip to a key or combo to rotate the dongle display 180 degrees. */
        /omit-if-no-ref/ dflip: dflip {
            compatible = "zmk,behavior-display-flip";
            #binding-cells = <0>;
            display-name = "Flip Display";
        };
    };
};
